## prj.conf
```kconfig
#
# Copyright (c) 2024 Nordic Semiconductor ASA
#
# SPDX-License-Identifier: LicenseRef-Nordic-5-Clause
#

# Kconfigs necessary to build the application as a recovery application

CONFIG_SUIT_RECOVERY=y

# It is the main application which is responsible for flashing and generating the UICR
# configuration - the recovery application should not do it.
CONFIG_NRF_REGTOOL_GENERATE_UICR=n
CONFIG_NRF_REGTOOL_GENERATE_BICR=n

############

# Kconfigs needed to provide the recovery application functionality

# Enable mcumgr
CONFIG_NET_BUF=y
CONFIG_ZCBOR=y
CONFIG_ZCBOR_CANONICAL=y
CONFIG_MCUMGR=y
CONFIG_MCUMGR_SMP_LEGACY_RC_BEHAVIOUR=y

# Enable SUIT services
CONFIG_SUIT=y
CONFIG_MGMT_SUITFU=y
CONFIG_FLASH=y

CONFIG_MCUMGR_GRP_OS=y
CONFIG_MGMT_SUITFU_GRP_SUIT=y
#CONFIG_MGMT_SUITFU_GRP_SUIT_IMAGE_FETCH=n
CONFIG_MGMT_SUITFU_GRP_IMG=n
CONFIG_MCUMGR_GRP_OS_BOOTLOADER_INFO=y
CONFIG_MCUMGR_GRP_OS_ECHO=n
CONFIG_MCUMGR_GRP_OS_INFO=n

##################
# Bluetooth config

CONFIG_BT=y
CONFIG_BT_PERIPHERAL=y

# Allow for large Bluetooth data packets.
CONFIG_BT_L2CAP_TX_MTU=498
CONFIG_BT_BUF_ACL_RX_SIZE=502
CONFIG_BT_BUF_ACL_TX_SIZE=502

# Enable the Bluetooth mcumgr transport (unauthenticated).
CONFIG_MCUMGR_TRANSPORT_BT=y
CONFIG_MCUMGR_TRANSPORT_BT_PERM_RW=y
CONFIG_MCUMGR_TRANSPORT_BT_CONN_PARAM_CONTROL=y

# Disable SMP over UART
# CONFIG_MCUMGR_TRANSPORT_UART=n

# Enable the mcumgr Packet Reassembly feature over Bluetooth and its configuration dependencies.
# MCUmgr buffer size is optimized to fit one SMP packet divided into five Bluetooth Write Commands,
# transmitted with the maximum possible MTU value: 498 bytes.
CONFIG_MCUMGR_TRANSPORT_BT_REASSEMBLY=y
CONFIG_MCUMGR_TRANSPORT_NETBUF_SIZE=2475
CONFIG_MCUMGR_TRANSPORT_WORKQUEUE_STACK_SIZE=4096

CONFIG_BT_DEVICE_NAME="SUIT Recovery"

########

# Disable unneeded drivers, peripherals and features to optimize for size
CONFIG_SIZE_OPTIMIZATIONS=y

# Enable LTO
CONFIG_LTO=y
CONFIG_ISR_TABLES_LOCAL_DECLARATION=y

CONFIG_I2C=n
CONFIG_WATCHDOG=n
CONFIG_SPI=n
#CONFIG_GPIO=n
#CONFIG_SERIAL=n

CONFIG_FPU=n

CONFIG_BOOT_BANNER=n
CONFIG_NCS_BOOT_BANNER=n
CONFIG_BOOT_DELAY=0

#CONFIG_CONSOLE=n
#CONFIG_UART_CONSOLE=n
#CONFIG_STDOUT_CONSOLE=n
#CONFIG_PRINTK=n
#CONFIG_EARLY_CONSOLE=n

CONFIG_ARM_MPU=n

CONFIG_TIMESLICING=n
CONFIG_COMMON_LIBC_MALLOC=n
#CONFIG_LOG=n
CONFIG_ASSERT=n

CONFIG_BT_HCI_ACL_FLOW_CONTROL=n
CONFIG_BT_HCI_VS=n

CONFIG_BT_DEBUG_NONE=y
CONFIG_BT_ASSERT=n
CONFIG_BT_DATA_LEN_UPDATE=n
CONFIG_BT_PHY_UPDATE=n
CONFIG_BT_GATT_CACHING=n

CONFIG_BT_GATT_ENFORCE_SUBSCRIPTION=n
CONFIG_BT_GATT_READ_MULTIPLE=n
CONFIG_BT_GATT_READ_MULT_VAR_LEN=n
CONFIG_BT_GAP_AUTO_UPDATE_CONN_PARAMS=n

CONFIG_BT_CTLR_PRIVACY=n
CONFIG_BT_CTLR_PHY_2M=n

CONFIG_SSF_ECHO_SERVICE_ENABLED=n
CONFIG_SSF_RESET_EVT_SERVICE_ENABLED=n


#Serial SMP
CONFIG_BASE64=y
CONFIG_MCUMGR_TRANSPORT_UART=y
CONFIG_UART_MCUMGR_RX_BUF_SIZE=1040
CONFIG_MCUMGR_TRANSPORT_UART_MTU=1024
CONFIG_NET_BUF=y
CONFIG_ZCBOR=y
CONFIG_ZCBOR_CANONICAL=y
CONFIG_MCUMGR=y
CONFIG_MCUMGR_SMP_LEGACY_RC_BEHAVIOUR=y
CONFIG_CRC=y


CONFIG_LOG=y
#CONFIG_CONSOLE=y
#CONFIG_UART_CONSOLE=y
#CONFIG_STDOUT_CONSOLE=y
CONFIG_PRINTK=y
CONFIG_GPIO=y
CONFIG_SERIAL=y
CONFIG_SUIT_CLEANUP_ON_INIT=n
CONFIG_SUIT_STREAM_IPC_PROVIDER=y
CONFIG_MGMT_SUITFU_GRP_SUIT_IMAGE_FETCH=y
CONFIG_SUIT_STREAM_FETCH_SOURCE_MGR=y
CONFIG_SUIT_STREAM_SOURCE_IPC=y
CONFIG_SUIT_STREAM=y
```

## src/main.c
```c
/*
 * Copyright (c) 2024 Nordic Semiconductor ASA
 *
 * SPDX-License-Identifier: LicenseRef-Nordic-5-Clause
 */

#include <zephyr/kernel.h>
#include <zephyr/sys/printk.h>
#include <zephyr/logging/log.h>
#include "common.h"

LOG_MODULE_REGISTER(app);

int main(void)
{
	if (IS_ENABLED(CONFIG_MCUMGR_TRANSPORT_BT)) {
		start_smp_bluetooth_adverts();
	}

	k_msleep(250);
	printk("\nRECOVERY APP, BUILD: %s %s\r\n", __DATE__, __TIME__);
	return 0;
}
```
