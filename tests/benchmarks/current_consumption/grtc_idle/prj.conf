## prj.conf
```kconfig
CONFIG_CONSOLE=y
CONFIG_UART_CONSOLE=y
CONFIG_SERIAL=y
CONFIG_POWEROFF=y

CONFIG_SOC_NRF_FORCE_CONSTLAT=y
CONFIG_NRF_SYS_EVENT=y
CONFIG_LOG_BUFFER_SIZE=16384

CONFIG_NRF_TRACE_UTILS=y

#CONFIG_CODE_DATA_RELOCATION=y
#CONFIG_SRAM_VECTOR_TABLE=y
#CONFIG_SRAM_SW_ISR_TABLE=y
```

## src/main.c
```c
/*
 * Copyright (c) 2024 Nordic Semiconductor ASA
 *
 * SPDX-License-Identifier: LicenseRef-Nordic-5-Clause
 */

#include <zephyr/kernel.h>

void trace_utils_init(void);
void trace_utils_report(void);

int main(void)
{

	trace_utils_init();
	while (1) {

		k_msleep(10000);
		trace_utils_report();
	}

	return 0;
}
```
